## CMakeLists.txt
```
cmake_minimum_required(VERSION 3.11)

include ($ENV{ZEPHYR_BASE}/cmake/app/boilerplate.cmake NO_POLICY_SCOPE)
project(NONE)

#target_sources(app PRIVATE src/main.c src/udp.c)
target_sources(app PRIVATE src/main.c)
```

## sample.yaml
```
sample:
	name: Demonstration Sample for CC2538DK
tests:
	test:
		platform_whitelist: cc2538dk
	tags: cc2538 samples demo uart rf
```

## prj.conf
```kconfig
CONFIG_MAIN_STACK_SIZE=2048

# Generic networking options
CONFIG_NETWORKING=y
CONFIG_NET_IPV6=y
CONFIG_NET_IPV4=n
CONFIG_NET_UDP=y
CONFIG_NET_TCP=n
# Kernel options 
CONFIG_ENTROPY_GENERATOR=y
CONFIG_TEST_RANDOM_GENERATOR=y

# Logging
CONFIG_NET_LOG=y
CONFIG_NET_BUF_LOG=y
CONFIG_SYS_LOG_SHOW_COLOR=y
CONFIG_INIT_STACKS=y
CONFIG_PRINTK=y

# Network buffers
CONFIG_NET_STATISTICS=y
CONFIG_NET_PKT_RX_COUNT=28
CONFIG_NET_PKT_TX_COUNT=28

CONFIG_NET_BUF_RX_COUNT=28
CONFIG_NET_BUF_TX_COUNT=28
CONFIG_NET_CONTEXT_NET_PKT_POOL=y

# IP address options
CONFIG_NET_IF_UNICAST_IPV6_ADDR_COUNT=6
CONFIG_NET_IF_MCAST_IPV6_ADDR_COUNT=6
CONFIG_NET_MAX_CONTEXTS=10

# L2 Options
CONFIG_NET_L2_IEEE802154=y
CONFIG_NET_L2_IEEE802154_FRAGMENT_REASS_CACHE_SIZE=20
CONFIG_NET_L2_IEEE802154_REASSEMBLY_TIMEOUT=10

# Network shell
CONFIG_NET_SHELL=n

# Network application options and configuration
CONFIG_NET_APP=y
CONFIG_NET_APP_CLIENT=y
CONFIG_NET_CONFIG_SETTINGS=y
CONFIG_NET_CONFIG_NEED_IPV6=y
CONFIG_NET_CONFIG_NEED_IPV4=n
CONFIG_NET_CONFIG_MY_IPV6_ADDR="2001:db8::2"
CONFIG_NET_CONFIG_PEER_IPV6_ADDR="2001:db8::1"
CONFIG_NET_CONFIG_MY_IPV4_ADDR=""
CONFIG_NET_CONFIG_PEER_IPV4_ADDR=""

CONFIG_IEEE802154_TI_CC2538_RF=y

CONFIG_NET_CONFIG_IEEE802154_DEV_NAME="ti_cc2538_rf_radio"
CONFIG_IEEE802154_TI_CC2538_RF_DRV_NAME="ti_cc2538_rf_radio"
```

## src/main.c
```c
#include <zephyr.h>
#include <misc/printk.h>
#include <string.h>
#include <device.h>
#include <gpio.h>
#include <inc/hw_ioc.h>
#include <inc/hw_memmap.h>
#include <inc/hw_sys_ctrl.h>
#include "main.h"
#define SECONDS_TO_SLEEP (1)

struct device * led_gpio_dev = NULL;
struct device * btn_gpio_dev = NULL;
struct gpio_callback btn_callbacks;
void btn_handler(struct device *port, struct gpio_callback *cb, u32_t pins);

void init_gpio(void) {
	led_gpio_dev = device_get_binding(PORT_LEDS);
	btn_gpio_dev = device_get_binding(PORT_BTNS);
	gpio_pin_configure(led_gpio_dev, PIN_LED1, GPIO_DIR_OUT);
	gpio_pin_configure(led_gpio_dev, PIN_LED2, GPIO_DIR_OUT);
	gpio_pin_configure(led_gpio_dev, PIN_LED3, GPIO_DIR_OUT);
	gpio_pin_configure(led_gpio_dev, PIN_LED4, GPIO_DIR_OUT);
	gpio_pin_configure(btn_gpio_dev, PIN_BTN1, GPIO_DIR_IN | GPIO_INT | GPIO_INT_EDGE | GPIO_INT_ACTIVE_LOW | GPIO_PUD_PULL_UP);
	gpio_pin_configure(btn_gpio_dev, PIN_BTN2, GPIO_DIR_IN | GPIO_INT | GPIO_INT_EDGE | GPIO_INT_ACTIVE_LOW | GPIO_PUD_PULL_UP);
	gpio_pin_configure(btn_gpio_dev, PIN_BTN3, GPIO_DIR_IN | GPIO_INT | GPIO_INT_EDGE | GPIO_INT_ACTIVE_LOW | GPIO_PUD_PULL_UP);
	gpio_pin_configure(btn_gpio_dev, PIN_BTN4, GPIO_DIR_IN);
	gpio_init_callback(&btn_callbacks, btn_handler, MASK_BTN1 | MASK_BTN2 | MASK_BTN3);
	int x2 = gpio_add_callback(btn_gpio_dev, &btn_callbacks);
	int x3 = gpio_pin_enable_callback(btn_gpio_dev, PIN_BTN1);
	int x4 = gpio_pin_enable_callback(btn_gpio_dev, PIN_BTN2);
	int x5 = gpio_pin_enable_callback(btn_gpio_dev, PIN_BTN3);
	printk("btn callback setup: %d %d %d %d\n", x2, x3, x4, x5);
}

/* Application main Thread */
void main(void) {
	init_gpio();
	printk("main()\n");
	printk("LED1 on\n");
	gpio_pin_write(led_gpio_dev, PIN_LED1, 1);

	while (1) {
		printk("LED2 on\n");
		gpio_pin_write(led_gpio_dev, PIN_LED2, 1);
		k_sleep(SECONDS_TO_SLEEP * 1000);

		printk("LED2 off\n");
		gpio_pin_write(led_gpio_dev, PIN_LED2, 0);
		k_sleep(SECONDS_TO_SLEEP * 1000);

		printk("LED3 toggle\n");
		uint32_t l4 = 0;
		gpio_pin_read(led_gpio_dev, PIN_LED3, &l4);
		gpio_pin_write(led_gpio_dev, PIN_LED3, l4==0?1:0);
		k_sleep(SECONDS_TO_SLEEP * 1000);
	}
}

void btn_handler(struct device *port, struct gpio_callback *cb, u32_t pins) {
	printk("[Interrupt]\n");
	if (pins & MASK_BTN1) {
		gpio_pin_write(led_gpio_dev, PIN_LED4, 1);
	}
	if (pins & MASK_BTN2) {
		gpio_pin_write(led_gpio_dev, PIN_LED4, 0);
	}
	if (pins & MASK_BTN3) {
		printk("[BTN3 Interrupt!]\n");
	}
}
```

## src/main.h
```c
#ifndef __INC_MAIN_H
#define __INC_MAIN_H

/* Onboard LEDs and Switches */
#define PORT_LEDS ("GPIO_PORTC")
#define PIN_LED1 (0)
#define PIN_LED2 (1)
#define PIN_LED3 (2)
#define PIN_LED4 (3)
#define PORT_BTNS ("GPIO_PORTC")
#define PIN_BTN1 (4)
#define PIN_BTN2 (5)
#define PIN_BTN3 (6)
#define PIN_BTN4 (7)

#define MASK_BTN1 (1<<PIN_BTN1)
#define MASK_BTN2 (1<<PIN_BTN2)
#define MASK_BTN3 (1<<PIN_BTN3)
#define MASK_BTN4 (1<<PIN_BTN4)

#endif /* __INC_MAIN_H */
```
