## boards/arm/cc2538dk/Kconfig.board
```kconfig
# (Created by [TheM])

# Kconfig - TI CC2538 Development Kit Board

config BOARD_CC2538DK
	bool "TI CC2538DK Board"
	depends on SOC_TI_CC2538
```

## boards/arm/cc2538dk/Kconfig.defconfig
```kconfig
# (Created by [TheM])

# Kconfig - TI CC2538DK board configuration


if BOARD_CC2538DK

config BOARD
	default "cc2538dk"

endif # BOARD_CC2538DK
```

## boards/arm/cc2538dk/cc2538dk_defconfig
```kconfig
# (Created by [TheM])

# General options
CONFIG_SYS_CLOCK_HW_CYCLES_PER_SEC=32000000
CONFIG_FLASH=y
CONFIG_XIP=y
CONFIG_PRINTK=y
CONFIG_INIT_STACKS=y
CONFIG_ENTROPY_GENERATOR=y
CONFIG_TEST_RANDOM_GENERATOR=y

# Platform-specific options
CONFIG_ARM=y
CONFIG_CORTEX_M_SYSTICK=y
CONFIG_SOC_TI_CC2538=y
CONFIG_BOARD_CC2538DK=y

# Logging
CONFIG_SYS_LOG=y
#CONFIG_SYS_LOG_DEFAULT_LEVEL=4
CONFIG_SYS_LOG_SHOW_TAGS=y
CONFIG_SYS_LOG_SHOW_COLOR=y
#CONFIG_SYS_LOG_OVERRIDE_LEVEL=4

# GPIO driver (SoC specific)
CONFIG_GPIO=y
CONFIG_GPIO_TI_CC2538=y
CONFIG_GPIO_TI_CC2538_DRIVER_INIT_PRI=0
CONFIG_GPIO_TI_CC2538_PORTA=y
CONFIG_GPIO_TI_CC2538_PORTB=y
CONFIG_GPIO_TI_CC2538_PORTC=y
CONFIG_GPIO_TI_CC2538_PORTD=y
CONFIG_GPIO_TI_CC2538_PORTC_IRQ_PRI=5

# UART driver (SoC specific)
CONFIG_CONSOLE=y
CONFIG_CONSOLE_HAS_DRIVER=y
#CONFIG_UART_CONSOLE_ON_DEV_NAME="UART_0" #set by device tree
CONFIG_SERIAL=y
CONFIG_SERIAL_HAS_DRIVER=y
CONFIG_SERIAL_SUPPORT_INTERRUPT=y
CONFIG_UART_CONSOLE=y
CONFIG_UART_INTERRUPT_DRIVEN=y
CONFIG_UART_TI_CC2538=y
CONFIG_UART_TI_CC2538_INTERRUPTDRIVEN=y #both should work
CONFIG_UART_TI_CC2538_UART0=y
CONFIG_UART_TI_CC2538_UART0_INSLEEP=y
CONFIG_UART_TI_CC2538_UART0_INDEEPSLEEP=y
#choose ONE of those below
#CONFIG_UART_TI_CC2538_UART0_CLOCK_SYSTEM=y #does not work
CONFIG_UART_TI_CC2538_UART0_CLOCK_PIOSC=y #does work

# RF Driver
CONFIG_IEEE802154=y
CONFIG_IEEE802154_TI_CC2538_RF=y
# CONFIG_IEEE802154_TI_CC2538_RF_RANDOM_MAC=y

# Network
#CONFIG_NETWORKING=y
#CONFIG_NET_UDP=y
#CONFIG_NET_TCP=y
#CONFIG_NET_IPV4=y
#CONFIG_NET_APP_NEED_IPV4=y
#CONFIG_NET_IPV6=y
#CONFIG_NET_APP_AUTO_INIT=y
#CONFIG_NET_APP_INIT_TIMEOUT=10
#CONFIG_NET_APP_NEED_IPV6=y
#CONFIG_NET_APP_NEED_IPV6_ROUTER=n

# Network application options and configuration
#CONFIG_NET_APP_SETTINGS=y
#CONFIG_NET_APP_SERVER=y
#CONFIG_NET_APP_CLIENT=y
#CONFIG_NET_DEBUG_APP=n
#CONFIG_NET_APP_MY_IPV4_ADDR="192.0.2.10"
#CONFIG_NET_APP_MY_IPV6_ADDR="2001:db8::10"
#CONFIG_NET_APP_PEER_IPV4_ADDR="192.0.2.20"
#CONFIG_NET_APP_PEER_IPV6_ADDR="2001:db8::20"

# Network buffers
#CONFIG_NET_PKT_RX_COUNT=8
#CONFIG_NET_PKT_TX_COUNT=8
#CONFIG_NET_BUF_RX_COUNT=16
#CONFIG_NET_BUF_TX_COUNT=16
#CONFIG_NET_CONTEXT_NET_PKT_POOL=y

# IP address options
#CONFIG_NET_IF_UNICAST_IPV6_ADDR_COUNT=1
#CONFIG_NET_IF_MCAST_IPV6_ADDR_COUNT=1
#CONFIG_NET_MAX_CONTEXTS=4


# Random
#CONFIG_XOROSHIRO_RANDOM_GENERATOR=y

# TI SDK
CONFIG_TI_CC2538_HAS_SDK=y
CONFIG_TI_CC2538_USE_SDK=y
CONFIG_TI_CC2538_USE_SDK_DRIVERLIB=y
```

## drivers/gpio/Kconfig.ti_cc2538
```kconfig
# (Created by [TheM])

# Kconfig.cc2538- CC2538 GPIO configuration options
#

menuconfig GPIO_TI_CC2538
	bool "TI CC2538 GPIO driver"
	depends on GPIO && SOC_TI_CC2538
	default n
	help
	  Enable the GPIO driver on TI CC2538 boards

if GPIO_TI_CC2538

config GPIO_TI_CC2538_DRIVER_INIT_PRI
	int "GPIO initialization priority"
	range 0 5
	default 3
	help
		CC2538 GPIO Initializatzion priority	

# PORTA
config GPIO_TI_CC2538_PORTA
	bool "GPIO block A"
	depends on GPIO_TI_CC2538
	default n
	help
	  Include support for the GPIO PORT A.

config GPIO_TI_CC2538_PORTA_NAME
	string "GPIO PORTA device name"
	depends on GPIO_TI_CC2538_PORTA
	default "GPIO_PORTA"

config GPIO_TI_CC2538_PORTA_IRQ_PRI
	int "GPIO A interrupt priority"
	depends on GPIO_TI_CC2538_PORTA
	range 0 5
	default 1
	help
	  CC2538 GPIO A IRQ priority.
# END PORTA


# PORTB
config GPIO_TI_CC2538_PORTB
	bool "GPIO block B"
	depends on GPIO_TI_CC2538
	default n
	help
	  Include support for the GPIO PORT B.

config GPIO_TI_CC2538_PORTB_NAME
	string "GPIO PORTB device name"
	depends on GPIO_TI_CC2538_PORTB
	default "GPIO_PORTB"

config GPIO_TI_CC2538_PORTB_IRQ_PRI
	int "GPIO B interrupt priority"
	depends on GPIO_TI_CC2538_PORTB
	range 0 5
	default 1
	help
	  CC2538 GPIO B IRQ priority.
# END PORTB


# PORTC
config GPIO_TI_CC2538_PORTC
	bool "GPIO block C"
	depends on GPIO_TI_CC2538
	default n
	help
	  Include support for the GPIO PORT C.

config GPIO_TI_CC2538_PORTC_NAME
	string "GPIO PORTC device name"
	depends on GPIO_TI_CC2538_PORTC
	default "GPIO_PORTC"

config GPIO_TI_CC2538_PORTC_IRQ_PRI
	int "GPIO C interrupt priority"
	depends on GPIO_TI_CC2538_PORTC
	range 0 5
	default 1
	help
	  CC2538 GPIO C IRQ priority.
# END PORTC


# PORTD
config GPIO_TI_CC2538_PORTD
	bool "GPIO block D"
	depends on GPIO_TI_CC2538
	default n
	help
	  Include support for the GPIO PORT D.

config GPIO_TI_CC2538_PORTD_NAME
	string "GPIO PORTD device name"
	depends on GPIO_TI_CC2538_PORTD
	default "GPIO_PORTD"

config GPIO_TI_CC2538_PORTD_IRQ_PRI
	int "GPIO D interrupt priority"
	depends on GPIO_TI_CC2538_PORTD
	range 0 5
	default 1
	help
	  CC2538 GPIO D IRQ priority.
# END PORTC

endif # GPIO_TI_CC2538
```

## drivers/ieee802154/Kconfig.ti_cc2538
```kconfig
# (Created by [TheM])

# Kconfig.cc2538 - TI CC2538 configuration options
#

menuconfig IEEE802154_TI_CC2538_RF
	bool "TI CC2538 Driver support"
	depends on NETWORKING
	depends on NET_L2_IEEE802154
	default n

if IEEE802154_TI_CC2538_RF

config IEEE802154_TI_CC2538_RF_DRV_NAME
	string "TI CC2538 Driver's name"
	default "ti_cc2538_rf_radio"
	help
	This option sets the driver name

config IEEE802154_TI_CC2538_RF_RX_STACK_SIZE
	int "Driver's internal RX thread stack size"
	default 1024
	help
	This option sets the driver's stack size for its internal RX thread.
	The default value should be sufficient, but in case it proves to be
	a too little one, this option makes it easy to play with the size.

config IEEE802154_TI_CC2538_RF_INIT_PRIO
	int "CC2538 initialization priority"
	default 80
	help
	Set the initialization priority number. Do not mess with it unless
	you know what you are doing. And of course it has to start before the net stack.

config IEEE802154_TI_CC2538_RF_SHORT_ADDR
	hex "Short Address"
	default 0xdead
	range 0 0xffff
	help
	  This is the link layer short address.


config IEEE802154_TI_CC2538_RF_MAC
	hex "MAC Address"
	default 0x0123456789abcdef
	range 0 0xffffffffffffffff
	help
	  This is the link layer MAC address.

config IEEE802154_TI_CC2538_RF_MAC_RANDOM_BYTES
	int "Number of the right-most mac bytes to be randomized"
	default 4	
	range 0 8
	help
		The right-most x bytes of the mac address will be overwritten
		 on device initialization with random values.


endif # IEEE802154_TI_CC2538_RF
```

## drivers/serial/Kconfig.ti_cc2538
```kconfig
menuconfig UART_TI_CC2538
	depends on SOC_TI_CC2538
	bool "CC2538 UART driver"
	default n
	select SERIAL_HAS_DRIVER
	help
	  This option enables the CC2538 UART driver.

config UART_TI_CC2538_DRIVER_NAME
	string "TI CC2538 UART Drivername"
	depends on UART_TI_CC2538
	default "TI_CC2538_UART_DRIVER"


config UART_TI_CC2538_INTERRUPTDRIVEN
	depends on UART_TI_CC2538
	select UART_INTERRUPT_DRIVEN
	select SERIAL_SUPPORT_INTERRUPT
	bool "Enable Interrupt Driven UART"
	default n


#UART 0
config UART_TI_CC2538_UART0
	depends on UART_TI_CC2538
	bool "Configure UART0"
	default n
	help
		This option enables the configuration and usage of UART0

choice UART_TI_CC2538_UART0_CLOCK_SOURCE
	prompt "Select UART0 clock source"
	depends on UART_TI_CC2538_UART0
	config UART_TI_CC2538_UART0_CLOCK_SYSTEM
		bool "System Clock"
	config UART_TI_CC2538_UART0_CLOCK_PIOSC
		bool "Periperial IO Clock"
endchoice

config UART_TI_CC2538_UART0_INSLEEP
	depends on UART_TI_CC2538_UART0
	bool "Allow to continue operation Sleep Mode"
	default y
	help
	  This option allows to continue the Uart Module to continue Operation in Sleep Mode.
	  (Possibly Higher Power Consumption!)

config UART_TI_CC2538_UART0_INDEEPSLEEP
	depends on UART_TI_CC2538_UART0
	depends on UART_TI_CC2538_UART0_INSLEEP
	bool "Allow to continue operation DeepSleep Mode"
	default y
	help
	  This option allows to continue the Uart Module to continue Operation in Sleep Mode.
	  (Possibly Higher Power Consumption!)

config UART_TI_CC2538_UART0_FIFOS
	depends on UART_TI_CC2538_UART0
	bool "Enable RX/TX Hardware FIFOs."
	default n

#UART1
config UART_TI_CC2538_UART1
	depends on UART_TI_CC2538
	bool "Configure UART1"
	default n
	help
		This option enables the configuration and usage of UART1

choice UART_TI_CC2538_UART1_CLOCK_SOURCE
	prompt "Select UART1 clock source"
	depends on UART_TI_CC2538_UART1
	config UART_TI_CC2538_UART1_CLOCK_SYSTEM
		bool "System Clock"
	config UART_TI_CC2538_UART1_CLOCK_PIOSC
		bool "Periperial IO Clock"
endchoice

config UART_TI_CC2538_UART1_INSLEEP
	depends on UART_TI_CC2538_UART1
	bool "Allow to continue operation Sleep Mode"
	default n
	help
	  This option allows to continue the Uart Module to continue Operation in Sleep Mode.
	  (Possibly Higher Power Consumption!)

config UART_TI_CC2538_UART1_INDEEPSLEEP
	depends on UART_TI_CC2538_UART1
	depends on UART_TI_CC2538_UART1_INSLEEP
	bool "Allow to continue operation DeepSleep Mode"
	default n
	help
	  This option allows to continue the Uart Module to continue Operation in Sleep Mode.
	  (Possibly Higher Power Consumption!)

config UART_TI_CC2538_UART1_FIFOS
	depends on UART_TI_CC2538_UART1
	bool "Enable RX/TX Hardware FIFOs."
	default n
```

## dts/bindings/gpio/ti,cc2538-gpio.yaml
```yaml
# (Created by [TheM])
---
title: TI CC2538 GPIO
version: 0.1

description: >
    This is a representation of the TI CC2538 GPIO node

inherits:
    !include uart.yaml

properties:
    compatible:
      type: string
      category: required
      description: compatible strings
      constraint: "ti,cc2538-gpio"

    reg:
      type: int
      description: mmio register space
      generation: define
      category: required

    interrupts:
      type: compound
      category: required
      description: required interrupts
      generation: define
...
```

## ext/hal/ti/cc2538sdk/Kconfig
```kconfig
# (Created by [TheM])
# Kconfig - CC2538 SDK HAL configuration


config TI_CC2538_HAS_SDK
	bool
	default y

menuconfig TI_CC2538_USE_SDK
	bool "TI CC2538 SDK support"
	default y
	depends on TI_CC2538_HAS_SDK
	help
	Set when

if TI_CC2538_USE_SDK

config TI_CC2538_USE_SDK_DRIVERLIB
        bool "Enable building the CC2538 SDK files stored in the Zephyr tree"
        default y
        depends on TI_CC2538_USE_SDK
        help
        Link with local CC2538 SDK driverlib sources.

#config TI_CC2538_USE_SDK_ROMLIB
#        bool "Use the Peripheral Driver library functions in ROM"
#        default n
#        select TI_CC2538_USE_SDK
#        help
#        Vector to CC2538 SDK driverlib APIs in ROM.
#

endif
```

## soc/arm/ti_cc2538/Kconfig.defconfig
```kconfig
# (Created by [TheM])
#
# Kconfig - TI CC2538 platform configuration options

if SOC_TI_CC2538

config SOC
	default "ti_cc2538"

config NUM_IRQS
	int
	# must be >= the highest interrupt number used
	# could be less for primary instead of secondary table
	default 180

config SYS_CLOCK_HW_CYCLES_PER_SEC
	int
	default 32000000

if IEEE802154 && NET_CONFIG_SETTINGS && IEEE802154_TI_CC2538_RF
	config NET_CONFIG_IEEE802154_DEV_NAME
		default IEEE802154_TI_CC2538_RF_DRV_NAME
endif # IEEE802154 && NET_CONFIG_SETTINGS

endif # SOC_TI_CC2538
```

## soc/arm/ti_cc2538/Kconfig.soc
```kconfig
# (Created by [TheM])

config SOC_TI_CC2538
	bool "TI CC2538 SoC"
	select CPU_CORTEX_M3
	select CPU_HAS_SYSTICK
```
